## Documentation/devicetree/bindings/sound/awinic,aw88194.yaml
```yaml
# SPDX-License-Identifier: (GPL-2.0-only OR BSD-2-Clause)
%YAML 1.2
---
$id: http://devicetree.org/schemas/sound/awinic,aw88194.yaml#
$schema: http://devicetree.org/meta-schemas/core.yaml#

title: Awinic AW88194 smart audio amplifier

maintainers:
  - Ben Ropple <36946060+bropple@users.noreply.github.com>

description:
  The AW88194 is an I2S/TDM input mono class D amplifier with a boost
  converter and a speaker protection DSP, controlled over I2C. Its register
  settings come from the vendor's ACF container.

allOf:
  - $ref: dai-common.yaml#

properties:
  compatible:
    const: awinic,aw88194

  reg:
    maxItems: 1

  '#sound-dai-cells':
    const: 0

  reset-gpios:
    maxItems: 1

  interrupts:
    maxItems: 1

  firmware-name:
    maxItems: 1
    description: ACF container to load, default aw881xx_acf.bin

  awinic,dev-name:
    $ref: /schemas/types.yaml#/definitions/string
    description: Device name of the ACF register profile, default aw88194

required:
  - compatible
  - reg
  - '#sound-dai-cells'

unevaluatedProperties: false

examples:
  - |
    #include <dt-bindings/gpio/gpio.h>

    i2c {
        #address-cells = <1>;
        #size-cells = <0>;

        audio-amplifier@34 {
            compatible = "awinic,aw88194";
            reg = <0x34>;
            reset-gpios = <&gpio 66 GPIO_ACTIVE_LOW>;
            sound-name-prefix = "Speaker";
            #sound-dai-cells = <0>;
        };
    };
```
